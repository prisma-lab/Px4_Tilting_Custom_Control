## src/modules/prisma1_att_control/Kconfig
```kconfig
menuconfig MODULES_PRISMA1_ATT_CONTROL
	bool "prisma1_att_control"
	default n
	---help---
		Enable support for prisma1control

menuconfig USER_PRISMA1_ATT_CONTROL
	bool "prisma1_att_control running as userspace module"
	default y
	depends on BOARD_PROTECTED && MODULES_PRISMA1_ATT_CONTROL
	---help---
		Put prisma1control in userspace memory
```

## src/modules/prisma1control/Kconfig
```kconfig
menuconfig MODULES_PRISMA1CONTROL
	bool "prisma1control"
	default n
	---help---
		Enable support for prisma1control

menuconfig USER_PRISMA1CONTROL
	bool "prisma1control running as userspace module"
	default y
	depends on BOARD_PROTECTED && MODULES_PRISMA1CONTROL
	---help---
		Put prisma1control in userspace memory
```
